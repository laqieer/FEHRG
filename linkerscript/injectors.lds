INCLUDE ../linkerscript/title_screen.lds
INCLUDE ../linkerscript/battle_animation.lds
INCLUDE ../linkerscript/bgm.lds
INCLUDE ../linkerscript/game_mode_selection.lds
INCLUDE ../linkerscript/game_start.lds
INCLUDE ../linkerscript/portrait.lds
INCLUDE ../linkerscript/event.lds
INCLUDE ../linkerscript/voice.lds
INCLUDE ../linkerscript/font.lds
INCLUDE ../linkerscript/text.lds
INCLUDE ../linkerscript/option.lds
INCLUDE ../linkerscript/chapter_title.lds
INCLUDE ../linkerscript/character.lds
INCLUDE ../linkerscript/class.lds
INCLUDE ../linkerscript/standing_unit_icon.lds
INCLUDE ../linkerscript/moving_unit_icon.lds
INCLUDE ../linkerscript/improved_sound_mixer.lds
INCLUDE ../linkerscript/background.lds
INCLUDE ../linkerscript/music.lds
INCLUDE ../linkerscript/sound_room.lds
INCLUDE ../linkerscript/terrain_name.lds
INCLUDE ../linkerscript/chapter.lds
INCLUDE ../linkerscript/chapter_map.lds
INCLUDE ../linkerscript/chapter_event.lds
INCLUDE ../linkerscript/unit.lds
INCLUDE ../linkerscript/other_texts.lds
INCLUDE ../linkerscript/menu.lds
INCLUDE ../linkerscript/storage.lds
INCLUDE ../linkerscript/chapter_op.lds
